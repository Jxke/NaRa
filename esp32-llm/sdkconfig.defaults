## esp32-llm/sdkconfig.defaults
```kconfig
# Custom partition table
CONFIG_PARTITION_TABLE_CUSTOM=y
CONFIG_PARTITION_TABLE_CUSTOM_FILENAME="partitions.csv"
CONFIG_PARTITION_TABLE_OFFSET=0x8000

# 32MB Flash
CONFIG_ESPTOOLPY_FLASHSIZE_32MB=y
CONFIG_ESPTOOLPY_FLASHSIZE="32MB"

# 16MB Octal PSRAM (ESP32-S3-DEV-KIT-N32R16V-M)
CONFIG_ESP32S3_SPIRAM_SUPPORT=y
CONFIG_SPIRAM=y
CONFIG_SPIRAM_MODE_OCT=y
CONFIG_SPIRAM_TYPE_AUTO=y
CONFIG_SPIRAM_SPEED_80M=y
CONFIG_SPIRAM_ALLOW_STACK_EXTERNAL_MEMORY=y

# CPU 240MHz for best inference speed
CONFIG_ESP32S3_DEFAULT_CPU_FREQ_240=y

# Instruction cache size 32KB (important for LLM performance)
CONFIG_ESP32S3_INSTRUCTION_CACHE_32KB=y
```
